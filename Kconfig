## Kconfig
```kconfig
#
# For a description of the syntax of this configuration file,
# see Documentation/kbuild/kconfig-language.txt.
#
mainmenu "Linux/$ARCH $KERNELVERSION Kernel Configuration"

config SRCARCH
	string
	option env="SRCARCH"

menu "PASR Project"
config PRINT_BUDDY_FREELIST
	bool "print the free list"
	default n

config FORCE_MAX_ZONEORDER
	int "MAX_ZONEORDER"
	default 15

config MM_OPT
	bool "memory management opt"
	default n

config MM_OPT_FILE
	bool "memory management opt for file cache"
	default n

config MM_OPT_VM
	bool "memory management opt for vm"
	default n

config MM_OPT_VMALLOC
	bool "memory management opt for vmalloc"
	default n

config MM_OPT_RX
	bool "memory management opt for readonly exec file"
	default n

config MM_OPT_SHMEM
	bool "memory management opt for shmem"
	default n
endmenu

source "arch/$SRCARCH/Kconfig"
```
